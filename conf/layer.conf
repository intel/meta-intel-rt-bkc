## conf/layer.conf
```bitbake
# We have a conf and classes directory, add to BBPATH
BBPATH .= ":${LAYERDIR}"

# We have recipes-* directories, add to BBFILES
BBFILES += "${LAYERDIR}/recipes-*/*/*.bb \
            ${LAYERDIR}/recipes-*/*/*.bbappend"

BBFILE_COLLECTIONS += "intel-ikt-rt"
BBFILE_PATTERN_intel-ikt-rt := "^${LAYERDIR}/"

# Defining priority for recipes from this layer
BBFILE_PRIORITY_intel-ikt-rt = "6"

LAYERSERIES_COMPAT_intel-ikt-rt = "thud warrior zeus dunfell"

# Defining dependencies of this layer
LAYERDEPENDS_intel-ikt-rt = "intel"

LTTNGMODULES_corei7-64-intel-common = ""
LTTNGMODULES_core2-32-intel-common = ""
require conf/include/meta-intel-ikt-rt.inc
```
